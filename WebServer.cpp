#include "WebServer.h"
#include "SPIFFS.h"

const uint8_t edit_htm_gz[] PROGMEM = {
    0x1f, 0x8b, 0x08, 0x00, 0x00, 0x00, 0x00, 0x00, 0x00, 0xff, 0xb5, 0x5a, 0x0d, 0x5f, 0xdb, 0x38, 0xd2, 0xff, 0x2a, 0xaa, 0x7b, 0xdb, 0x3a, 0x07, 0x71, 0x12, 0xa0, 0x6c, 0x1b, 0x30, 0xdd, 
    0x04, 0x68, 0x69, 0x79, 0x27, 0x49, 0x5b, 0xda, 0xe3, 0xd9, 0x9f, 0x62, 0x2b, 0xb1, 0xc0, 0x96, 0x5d, 0x5b, 0x26, 0xd0, 0x6c, 0xbe, 0xfb, 0xcd, 0x48, 0x76, 0x6c, 0x87, 0xd0, 0x97, 0x7d, 
    0x6e, 0x4b, 0x21, 0xb2, 0xa4, 0x91, 0x66, 0x46, 0x33, 0xff, 0x99, 0x91, 0xb3, 0xfd, 0x64, 0xef, 0x74, 0xb7, 0x7f, 0x79, 0xb6, 0x4f, 0x3c, 0x19, 0xf8, 0x3b, 0xdb, 0xf8, 0x97, 0xf8, 0x54, 
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    0xd0, 0x62, 0x2d, 0x00, 0x00
};
const int edit_htm_gz_len = sizeof(edit_htm_gz)/sizeof(uint8_t);

WebServerDefaultHandler::WebServerDefaultHandler(const fs::FS& fs, const String& username, const String& password)
    : AsyncWebHandler(), _fs(fs)
{
    this->_username = username;
    this->_password = password;
    this->_authenticated = false;
    this->_startTime = 0;
    this->setAuthentication(username.c_str(), password.c_str());
}

bool WebServerDefaultHandler::canHandle(AsyncWebServerRequest *request) 
{
    if(request->url().equalsIgnoreCase("/spiffs")  || 
       request->url().equalsIgnoreCase("/spiffs/") ||
       request->url().equalsIgnoreCase("/spiffs/edit") )
    {
        if(request->method() == HTTP_GET)
        {
            if(request->hasParam("list"))
            {
                return true;
            }
            
            if(request->hasParam("edit"))
            {
                request->_tempFile = _fs.open(request->arg("edit"), "r");
                if(!request->_tempFile)
                {
                    return false;
                }
                if(request->_tempFile.isDirectory())
                {
                    request->_tempFile.close();
                    return false;
                }
            }
            if(request->hasParam("download"))
            {
                request->_tempFile = _fs.open(request->arg("download"), "r");
                if(!request->_tempFile)
                {
                    return false;
                }
                if(request->_tempFile.isDirectory())
                {
                    request->_tempFile.close();
                    return false;
                }
            }
            request->addInterestingHeader("If-Modified-Since");
            return true;
        }
        else if(request->method() == HTTP_POST || request->method() == HTTP_DELETE || request->method() == HTTP_PUT)
        {
            return true;
        }
    }
    return false;
}

void WebServerDefaultHandler::handleRequest(AsyncWebServerRequest *request)
{
    if(_username.length() && _password.length() && !request->authenticate(_username.c_str(), _password.c_str()))
    {
        return request->requestAuthentication();
    }

    if(request->url().equalsIgnoreCase("/spiffs")  || 
       request->url().equalsIgnoreCase("/spiffs/") ||
       request->url().equalsIgnoreCase("/spiffs/edit") )
    {
        if(request->method() == HTTP_GET)
        {
            if(request->hasParam("list")){
                String path = request->getParam("list")->value();
                File dir = _fs.open(path);

                path = String();
                String output = "[";
                File entry = dir.openNextFile();
                while(entry)
                {
                    if (output != "[") 
                    {
                        output += ',';
                    }
                    output += "{\"type\":\"";
                    output += "file";
                    output += "\",\"name\":\"";
                    output += String(entry.name());
                    output += "\",\"size\":";
                    output += String(entry.size());
                    output += "}";

                    entry = dir.openNextFile();
                }
                dir.close();
                output += "]";
                request->send(200, "application/json", output);
                output = String();
            }
            else if(request->hasParam("edit") || request->hasParam("download"))
            {
                request->send(request->_tempFile, request->_tempFile.name(), String(), request->hasParam("download"));
            }
            else 
            {
                const char * buildTime = __DATE__ " " __TIME__ " GMT";
                if (request->header("If-Modified-Since").equals(buildTime)) 
                {
                    request->send(304);
                } 
                else 
                {
                    AsyncWebServerResponse *response = request->beginResponse_P(200, "text/html", edit_htm_gz, edit_htm_gz_len);
                    response->addHeader("Content-Encoding", "gzip");
                    response->addHeader("Last-Modified", buildTime);
                    request->send(response);
                }
            }
        } 
        else if(request->method() == HTTP_DELETE)
        {
            if(request->hasParam("path", true))
            {
                _fs.remove(request->getParam("path", true)->value());
                request->send(200, "", "DELETE: "+request->getParam("path", true)->value());
            } 
            else
            {
                request->send(404);
            } 
        }
        else if(request->method() == HTTP_POST)
        {
            if(request->hasParam("data", true, true) && _fs.exists(request->getParam("data", true, true)->value()))
            {
                request->send(200, "", "UPLOADED: "+request->getParam("data", true, true)->value());
            }
            else
            {
                request->send(500);
            }
        } 
        else if(request->method() == HTTP_PUT)
        {
            if(request->hasParam("path", true))
            {
                String filename = request->getParam("path", true)->value();
                if(_fs.exists(filename))
                {
                    request->send(200);
                } 
                else 
                {
                    fs::File f = _fs.open(filename, "w");
                    if(f)
                    {
                        f.write((uint8_t)0x00);
                        f.close();
                        request->send(200, "", "CREATE: "+filename);
                    } 
                    else 
                    {
                        request->send(500);
                    }
                }
            } 
            else
            {
                request->send(400);
            }
        }
    }    
}

void WebServerDefaultHandler::handleUpload(AsyncWebServerRequest *request, const String& filename, size_t index, uint8_t *data, size_t len, bool final)
{
    if(request->url().equalsIgnoreCase("/spiffs")  || 
       request->url().equalsIgnoreCase("/spiffs/") ||
       request->url().equalsIgnoreCase("/spiffs/edit") )
    {
        if(!index)
        {
            if(!_username.length() || request->authenticate(_username.c_str(),_password.c_str()))
            {
                _authenticated = true;
                request->_tempFile = _fs.open(filename, "w");
                _startTime = millis();
            }
        }
        if(_authenticated && request->_tempFile)
        {
            if(len)
            {
                request->_tempFile.write(data,len);
            }
            if(final)
            {
                request->_tempFile.close();
            }
        }        
    }
}

bool WebServerDefaultHandler::isRequestHandlerTrivial()
{
    return false;
}

WebServer::WebServer(uint16_t listenPort,const String& username, const String& password)
    : server(listenPort), requestHandler(SPIFFS, username, password)
{
    this->server.addHandler(&this->requestHandler);
    this->server.serveStatic("/", SPIFFS, "/www").setDefaultFile("index.html");
    this->server.onNotFound([](AsyncWebServerRequest *request)
        {
            Serial.printf("NOT_FOUND: ");
            if(request->method() == HTTP_GET)
                Serial.printf("GET");
            else if(request->method() == HTTP_POST)
                Serial.printf("POST");
            else if(request->method() == HTTP_DELETE)
                Serial.printf("DELETE");
            else if(request->method() == HTTP_PUT)
                Serial.printf("PUT");
            else if(request->method() == HTTP_PATCH)
                Serial.printf("PATCH");
            else if(request->method() == HTTP_HEAD)
                Serial.printf("HEAD");
            else if(request->method() == HTTP_OPTIONS)
                Serial.printf("OPTIONS");
            else
                Serial.printf("UNKNOWN");
            
            Serial.printf(" http://%s%s\n", request->host().c_str(), request->url().c_str());

            if(request->contentLength())
            {
                Serial.printf("_CONTENT_TYPE: %s\n", request->contentType().c_str());
                Serial.printf("_CONTENT_LENGTH: %u\n", request->contentLength());
            }

            int headers = request->headers();
            int i;
            for(i=0;i<headers;i++)
            {
                AsyncWebHeader* h = request->getHeader(i);
                Serial.printf("_HEADER[%s]: %s\n", h->name().c_str(), h->value().c_str());
            }

            int params = request->params();
            for(i=0;i<params;i++)
            {
                AsyncWebParameter* p = request->getParam(i);
                if(p->isFile())
                {
                    Serial.printf("_FILE[%s]: %s, size: %u\n", p->name().c_str(), p->value().c_str(), p->size());
                } 
                else if(p->isPost())
                {
                    Serial.printf("_POST[%s]: %s\n", p->name().c_str(), p->value().c_str());
                } 
                else {
                    Serial.printf("_GET[%s]: %s\n", p->name().c_str(), p->value().c_str());
                }
            }

            request->send(404);
        }
    );
    
    server.onFileUpload([](AsyncWebServerRequest *request, const String& filename, size_t index, uint8_t *data, size_t len, bool final)
        {
            if(!index)
            {
                Serial.printf("UploadStart: %s\n", filename.c_str());
            }
            Serial.printf("%s", (const char*)data);
            if(final)
            {
                Serial.printf("UploadEnd: %s (%u)\n", filename.c_str(), index+len);
            }
        }
    );

    server.onRequestBody([](AsyncWebServerRequest *request, uint8_t *data, size_t len, size_t index, size_t total)
        {
            if(!index){
                Serial.printf("BodyStart: %u\n", total);
            }
            
            Serial.printf("%s", (const char*)data);
            if(index + len == total){
                Serial.printf("BodyEnd: %u\n", total);
            }
        }
    );
}

void WebServer::begin()
{
    this->server.begin();
}

void WebServer::end()
{
    this->server.end();
}